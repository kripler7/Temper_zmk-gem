## boards/shields/temper/Kconfig.defconfig
```kconfig
if SHIELD_TEMPER_LEFT

config ZMK_KEYBOARD_NAME
    default "temper"

config ZMK_SPLIT_ROLE_CENTRAL
    default y

endif

if SHIELD_TEMPER_LEFT || SHIELD_TEMPER_RIGHT

config ZMK_SPLIT
    default y

endif

# Add idle timeout configuration
config ZMK_IDLE_TIMEOUT
    int "Milliseconds of inactivity before entering idle state"
    default 30000
```

## config/west.yml
```yaml
manifest:
  remotes:
    - name: zmkfirmware
      url-base: https://github.com/zmkfirmware
    - name: gpeye
      url-base: https://github.com/GPeye
  projects:
    - name: mario-peripheral-animation
      remote: gpeye
      revision: main 
    - name: zmk
      remote: zmkfirmware
      revision: main
      import: app/west.yml
  self:
    path: config
```
